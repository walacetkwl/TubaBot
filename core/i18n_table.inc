// Traduções da interface do aparelho: {pt-BR (texto-fonte), inglês, espanhol (América Latina)}.
// Regra: todo texto que aparece na tela precisa estar aqui. O teste "i18n_all_screens"
// percorre todas as telas em inglês e espanhol e falha se algum texto ficar sem tradução.
// Texto vazio na coluna = usa o português.
static const TrEntry TR_TABLE[] = {
  // ── geral / abertura / rosto ──
  {"Oi", "Hi", "Hola"},
  {"Olá", "Hello", "Hola"},
  {"Bom dia", "Good morning", "Buenos días"},
  {"Boa tarde", "Good afternoon", "Buenas tardes"},
  {"Boa noite", "Good evening", "Buenas noches"},
  {"Menu", "Menu", "Menú"},
  {"Mais apps", "More apps", "Más apps"},
  {"Jogos", "Games", "Juegos"},
  {"Pomodoro", "Pomodoro", "Pomodoro"},
  {"Timer", "Timer", "Temporizador"},
  {"Aparência", "Appearance", "Apariencia"},
  {"Volume", "Volume", "Volumen"},
  {"Brilho", "Brightness", "Brillo"},
  {"Wi-Fi", "Wi-Fi", "Wi-Fi"},
  {"Sistema", "System", "Sistema"},
  {"Cronômetro", "Stopwatch", "Cronómetro"},
  {"Alarmes", "Alarms", "Alarmas"},
  {"Relógio", "Clock", "Reloj"},
  {"Clima", "Weather", "Clima"},
  {"Respirar", "Breathe", "Respirar"},
  {"Sorteio", "Random", "Sorteo"},
  {"Expressões", "Expressions", "Expresiones"},
  {"Meu Tuba", "My Tuba", "Mi Tuba"},
  {"Lendárias", "Legendary", "Legendarias"},
  {"Nível", "Level", "Nivel"},
  {"Sobre", "About", "Acerca de"},
  {"Hoje", "Today", "Hoy"},
  {"desligado", "off", "apagado"},
  {"ligado", "on", "encendido"},
  {"nunca", "never", "nunca"},
  {"Ok", "OK", "OK"},
  {"Adiado", "Snoozed", "Pospuesto"},
  {"Atualizado!", "Updated!", "¡Actualizado!"},
  {"Nova: ", "New: ", "Nueva: "},
  {"Ainda bloqueada", "Still locked", "Aún bloqueada"},
  {"Bloqueada", "Locked", "Bloqueada"},
  {"Usar", "Use", "Usar"},
  {"Coleção ", "Collection ", "Colección "},
  {"toque para sair", "tap to exit", "toca para salir"},
  {"não desligue", "do not turn off", "no lo apagues"},
  {"Atualizando...", "Updating...", "Actualizando..."},
  // ── listas ──
  {"Recorde: ", "Best: ", "Récord: "},
  {" peixes", " fish", " peces"},
  {"peixes", "fish", "peces"},
  {"personalizado no portal", "custom in the portal", "personalizado en el portal"},
  {"Tema", "Theme", "Tema"},
  {"Claro", "Light", "Claro"},
  {"Escuro", "Dark", "Oscuro"},
  {"claro", "light", "claro"},
  {"escuro", "dark", "oscuro"},
  {"Cor das expressões", "Expression color", "Color de las expresiones"},
  {"rosto limpo", "clean face", "rostro limpio"},
  {" item", " item", " elemento"},
  {" itens", " items", " elementos"},
  {"Informações na tela", "On-screen info", "Información en pantalla"},
  {"Brilho dos olhos", "Eye glow", "Brillo de los ojos"},
  {"Digital", "Digital", "Digital"},
  {"Analógico", "Analog", "Analógico"},
  {"Tuba", "Tuba", "Tuba"},
  {"Mostrar hora", "Show time", "Mostrar hora"},
  {"Mostrar clima", "Show weather", "Mostrar clima"},
  {"Mostrar bateria", "Show battery", "Mostrar batería"},
  {"Rede de casa", "Home network", "Red de casa"},
  {"não configurada", "not set up", "no configurada"},
  {"conectando...", "connecting...", "conectando..."},
  {"sem conexão", "no connection", "sin conexión"},
  {"Configurar pelo celular", "Set up with your phone", "Configurar con el celular"},
  {"QR Code + portal", "QR code + portal", "Código QR + portal"},
  {"Rede do Tuba", "Tuba's network", "Red del Tuba"},
  {"Esquecer rede de casa", "Forget home network", "Olvidar red de casa"},
  {"Personalidade", "Personality", "Personalidad"},
  {"Tranquilo", "Calm", "Tranquilo"},
  {"Brincalhão", "Playful", "Juguetón"},
  {"Animação", "Animation", "Animación"},
  {"Calma", "Calm", "Calma"},
  {"Normal", "Normal", "Normal"},
  {"Animada", "Lively", "Animada"},
  {"Apagar a tela", "Screen off", "Apagar la pantalla"},
  {"Formato 24 h", "24-hour format", "Formato 24 h"},
  {"Silencioso", "Silent", "Silencio"},
  {"Reagir a sons", "React to sounds", "Reaccionar a sonidos"},
  {"Reagir a movimento", "React to motion", "Reaccionar al movimiento"},
  {"Girar 180°", "Rotate 180°", "Girar 180°"},
  {"Idioma", "Language", "Idioma"},
  {"em uso", "in use", "en uso"},
  {"Atualizações", "Updates", "Actualizaciones"},
  {"nova versão", "new version", "nueva versión"},
  {"Estatísticas anônimas", "Anonymous statistics", "Estadísticas anónimas"},
  {"Informações", "Information", "Información"},
  {"Restaurar padrão de fábrica", "Factory reset", "Restablecer de fábrica"},
  {"secreta por descobrir", "secret to discover", "secreta por descubrir"},
  {"secretas por descobrir", "secrets to discover", "secretas por descubrir"},
  {"aparecem sozinhas, de vez em quando", "they appear on their own, now and then", "aparecen solas, de vez en cuando"},
  {"Continue cuidando do Tuba...", "Keep taking care of Tuba...", "Sigue cuidando al Tuba..."},
  {"Duração do timer ", "Timer length ", "Duración del temporizador "},
  // ── toasts e avisos ──
  {"Ative o clima no portal", "Turn on weather in the portal", "Activa el clima en el portal"},
  {"Rede do Tuba fechada", "Tuba's network closed", "Red del Tuba cerrada"},
  {"Rede do Tuba aberta", "Tuba's network open", "Red del Tuba abierta"},
  {"Ajuste a hora primeiro", "Set the time first", "Ajusta la hora primero"},
  {"Alarme salvo", "Alarm saved", "Alarma guardada"},
  {"Silencioso: ligado", "Silent: on", "Silencio: activado"},
  {"Silencioso: desligado", "Silent: off", "Silencio: desactivado"},
  {"Tema claro", "Light theme", "Tema claro"},
  {"Tema escuro", "Dark theme", "Tema oscuro"},
  {"Microfone ignorado", "Microphone ignored", "Micrófono ignorado"},
  {"Reagir a sons: ligado", "React to sounds: on", "Reaccionar a sonidos: activado"},
  {"Rede de casa esquecida", "Home network forgotten", "Red de casa olvidada"},
  {"Toque contínuo: limpe a tela", "Continuous touch: clean the screen", "Toque continuo: limpia la pantalla"},
  {"Bateria fraca", "Low battery", "Batería baja"},
  {"Sessão concluída", "Session complete", "Sesión completada"},
  {"Falha na atualização", "Update failed", "Falló la actualización"},
  {"Pomodoro em andamento", "Pomodoro running", "Pomodoro en curso"},
  {"Timer em andamento", "Timer running", "Temporizador en curso"},
  {"Cronômetro em andamento", "Stopwatch running", "Cronómetro en curso"},
  {"Jogo em andamento", "Game in progress", "Juego en curso"},
  {"Aviso na tela", "Alert on screen", "Aviso en pantalla"},
  {"Atualizando", "Updating", "Actualizando"},
  // ── relógio, hoje ──
  {"Hora não ajustada", "Time not set", "Hora no ajustada"},
  {"use o Wi-Fi ou o portal", "use Wi-Fi or the portal", "usa el Wi-Fi o el portal"},
  {"AM", "AM", "a. m."},
  {"PM", "PM", "p. m."},
  {"dom", "Sun", "dom"},
  {"seg", "Mon", "lun"},
  {"ter", "Tue", "mar"},
  {"qua", "Wed", "mié"},
  {"qui", "Thu", "jue"},
  {"sex", "Fri", "vie"},
  {"sáb", "Sat", "sáb"},
  {"domingo", "Sunday", "domingo"},
  {"segunda", "Monday", "lunes"},
  {"terça", "Tuesday", "martes"},
  {"quarta", "Wednesday", "miércoles"},
  {"quinta", "Thursday", "jueves"},
  {"sexta", "Friday", "viernes"},
  {"sábado", "Saturday", "sábado"},
  {"jan", "Jan", "ene"},
  {"fev", "Feb", "feb"},
  {"mar", "Mar", "mar"},
  {"abr", "Apr", "abr"},
  {"mai", "May", "may"},
  {"jun", "Jun", "jun"},
  {"jul", "Jul", "jul"},
  {"ago", "Aug", "ago"},
  {"set", "Sep", "sep"},
  {"out", "Oct", "oct"},
  {"nov", "Nov", "nov"},
  {"dez", "Dec", "dic"},
  {"local próprio", "custom location", "ubicación propia"},
  {"em ", "in ", "en "},
  {"Foco ", "Focus ", "Enfoque "},
  {"Pausa ", "Break ", "Pausa "},
  {"pausado", "paused", "en pausa"},
  {"Timer ", "Timer ", "Temporizador "},
  {"humor ", "mood ", "ánimo "},
  {"Tudo tranquilo por aqui", "All calm around here", "Todo tranquilo por aquí"},
  {"Bateria ", "Battery ", "Batería "},
  // ── ajustes rápidos, volume, brilho ──
  {"Ajustes rápidos", "Quick settings", "Ajustes rápidos"},
  {"deslize para cima: fechar", "swipe up: close", "desliza hacia arriba: cerrar"},
  {"Brilho reduzido à noite", "Dimmed at night", "Brillo reducido de noche"},
  {"sem alto-falante", "no speaker", "sin altavoz"},
  // ── Pomodoro, timers, cronômetro, alarmes ──
  {"Pomodoro · Foco", "Pomodoro · Focus", "Pomodoro · Enfoque"},
  {"Pomodoro · Pausa", "Pomodoro · Break", "Pomodoro · Pausa"},
  {"Pomodoro · Pausa longa", "Pomodoro · Long break", "Pomodoro · Pausa larga"},
  {"Limite atingido", "Limit reached", "Límite alcanzado"},
  {"volta ", "lap ", "vuelta "},
  {"uma vez", "once", "una vez"},
  {"todo dia", "every day", "todos los días"},
  {"seg a sex", "Mon–Fri", "lun a vie"},
  {"fim de semana", "weekend", "fin de semana"},
  {"ajuste a hora pelo Wi-Fi ou portal", "set the time via Wi-Fi or portal", "ajusta la hora por Wi-Fi o portal"},
  {"Acordar", "Wake up", "Despertar"},
  {"Alarme 2", "Alarm 2", "Alarma 2"},
  {"Alarme 3", "Alarm 3", "Alarma 3"},
  {"Beber água", "Drink water", "Tomar agua"},
  {"Alongar", "Stretch", "Estirarse"},
  {"Pausa", "Break", "Pausa"},
  // ── respiração, nível, sorteio ──
  {"Caixa 4-4-4-4", "Box 4-4-4-4", "Caja 4-4-4-4"},
  {"Relaxar 4-7-8", "Relax 4-7-8", "Relajar 4-7-8"},
  {"Coerente 5-5", "Coherent 5-5", "Coherente 5-5"},
  {"Inspire", "Breathe in", "Inhala"},
  {"Segure", "Hold", "Sostén"},
  {"Expire", "Breathe out", "Exhala"},
  {"Toque para começar", "Tap to start", "Toca para empezar"},
  {"Toque", "Tap", "Toca"},
  {"Sem sensor de movimento", "No motion sensor", "Sin sensor de movimiento"},
  {"Dado", "Dice", "Dado"},
  {"Cara ou coroa", "Heads or tails", "Cara o cruz"},
  {"Sim ou não", "Yes or no", "Sí o no"},
  {"Número 1–100", "Number 1–100", "Número 1–100"},
  {"Cara", "Heads", "Cara"},
  {"Coroa", "Tails", "Cruz"},
  {"Sim", "Yes", "Sí"},
  {"Não", "No", "No"},
  {"toque ou sacuda · título: modo", "tap or shake · title: mode", "toca o agita · título: modo"},
  {"toque para sortear · título: modo", "tap to draw · title: mode", "toca para sortear · título: modo"},
  // ── clima ──
  {"Clima desligado", "Weather off", "Clima apagado"},
  {"ative no portal (precisa do Wi-Fi de casa)", "turn on in the portal (needs home Wi-Fi)", "actívalo en el portal (requiere Wi-Fi de casa)"},
  {"Buscando previsão...", "Fetching forecast...", "Buscando pronóstico..."},
  {"Sem rede de casa", "No home network", "Sin red de casa"},
  {"falha ao consultar; tentando de novo", "request failed; retrying", "falló la consulta; reintentando"},
  {"máx ", "high ", "máx "},
  {"°  mín ", "°  low ", "°  mín "},
  {"°  umid. ", "°  hum. ", "°  hum. "},
  {"hoje", "today", "hoy"},
  {"amanhã", "tomorrow", "mañana"},
  {"depois", "after", "después"},
  {" · há ", " · ", " · hace "},
  {" min · Open-Meteo", " min ago · Open-Meteo", " min · Open-Meteo"},
  {"Céu limpo", "Clear sky", "Cielo despejado"},
  {"Poucas nuvens", "Few clouds", "Pocas nubes"},
  {"Nublado", "Cloudy", "Nublado"},
  {"Neblina", "Fog", "Neblina"},
  {"Garoa", "Drizzle", "Llovizna"},
  {"Chuva", "Rain", "Lluvia"},
  {"Neve", "Snow", "Nieve"},
  {"Pancadas de chuva", "Showers", "Chubascos"},
  {"Tempestade", "Storm", "Tormenta"},
  // ── Meu Tuba ──
  {"Humor", "Mood", "Ánimo"},
  {"Energia", "Energy", "Energía"},
  {"Vínculo", "Bond", "Vínculo"},
  {" carinhos · ", " pets · ", " caricias · "},
  {" pomodoros", " pomodoros", " pomodoros"},
  {" partidas", " games", " partidas"},
  {" expressões", " expressions", " expresiones"},
  // ── primeiro uso / configuração ──
  {"Bem-vindo!", "Welcome!", "¡Bienvenido!"},
  {"Rede e portal", "Network and portal", "Red y portal"},
  {"1. Aponte a câmera", "1. Point your camera", "1. Apunta la cámara"},
  {"ou entre na rede:", "or join the network:", "o entra a la red:"},
  {"senha ", "password ", "contraseña "},
  {"2. Abra no navegador", "2. Open in the browser", "2. Abre en el navegador"},
  {"(funciona sem internet)", "(works without internet)", "(funciona sin internet)"},
  {"Casa: ", "Home: ", "Casa: "},
  {"não usada", "not used", "no usada"},
  {"conectando", "connecting", "conectando"},
  {"Rede própria fechada", "Own network closed", "Red propia cerrada"},
  {"fecha em ", "closes in ", "se cierra en "},
  {"Usar offline", "Use offline", "Usar sin conexión"},
  {"Fechar rede", "Close network", "Cerrar red"},
  // ── Informações ──
  {"Fábrica", "Factory", "Fábrica"},
  {"Rede", "Network", "Red"},
  {"Hora", "Time", "Hora"},
  {"Memória", "Memory", "Memoria"},
  {"Sensores", "Sensors", "Sensores"},
  {"Recordes", "Records", "Récords"},
  {"versão ", "version ", "versión "},
  {"ligado há ", "on for ", "encendido hace "},
  {"ESP32-S3 · tela 2,8\" 320×240", "ESP32-S3 · 2.8\" 320×240 screen", "ESP32-S3 · pantalla 2,8\" 320×240"},
  {"dados restaurados ao padrão", "data reset to defaults", "datos restablecidos"},
  {"Buscar atualizações", "Check for updates", "Buscar actualizaciones"},
  {"perfil de fábrica não gravado", "factory profile not written", "perfil de fábrica no grabado"},
  {"usando padrões genéricos (Lite)", "using generic defaults (Lite)", "usando valores genéricos (Lite)"},
  {"motivo: ", "reason: ", "motivo: "},
  {"modelo: ", "model: ", "modelo: "},
  {"cor física: ", "body color: ", "color físico: "},
  {"expressão padrão: ", "default expression: ", "expresión predeterminada: "},
  {"tema padrão: ", "default theme: ", "tema predeterminado: "},
  {"série: ", "serial: ", "serie: "},
  {"aviso: ", "warning: ", "aviso: "},
  {"rede própria: ligada", "own network: on", "red propia: activada"},
  {"rede própria: desligada", "own network: off", "red propia: desactivada"},
  {"casa: ", "home: ", "casa: "},
  {"desconectada", "disconnected", "desconectada"},
  {"funciona offline", "works offline", "funciona sin conexión"},
  {"lida do relógio da placa (RTC)", "read from the board clock (RTC)", "leída del reloj de la placa (RTC)"},
  {"ajustada pela rede/portal", "set by network/portal", "ajustada por red/portal"},
  {"hora não ajustada", "time not set", "hora no ajustada"},
  {"ajuste pelo Wi-Fi ou portal", "set it via Wi-Fi or portal", "ajústala por Wi-Fi o portal"},
  {"sem RTC: a hora volta pela rede ao religar", "no RTC: time returns via network after restart", "sin RTC: la hora vuelve por la red al reiniciar"},
  {"RAM livre ", "free RAM ", "RAM libre "},
  {"PSRAM livre ", "free PSRAM ", "PSRAM libre "},
  {"flash livre ", "free flash ", "flash libre "},
  {"simulador", "simulator", "simulador"},
  {"toque: ", "touch: ", "toque: "},
  {" bordas", " edges", " bordes"},
  {" (preso!)", " (stuck!)", " (¡atascado!)"},
  {"microfone: ausente", "microphone: absent", "micrófono: ausente"},
  {"som: desligado", "sound: off", "sonido: apagado"},
  {"som: nível ", "sound: level ", "sonido: nivel "},
  {" (base ", " (baseline ", " (base "},
  {"som: sem leitura", "sound: no reading", "sonido: sin lectura"},
  {"bateria: ", "battery: ", "batería: "},
  {"bateria: sem leitura", "battery: no reading", "batería: sin lectura"},
  {"bateria: não se aplica (Lite)", "battery: not applicable (Lite)", "batería: no aplica (Lite)"},
  {"movimento: ", "motion: ", "movimiento: "},
  {"movimento: sem leitura", "motion: no reading", "movimiento: sin lectura"},
  {"Pula: ", "Jump: ", "Salta: "},
  {"   Bote: ", "   Snap: ", "   Bocado: "},
  {"   Mergulho: ", "   Dive: ", "   Buceo: "},
  {"Reflexo: ", "Reflex: ", "Reflejo: "},
  {"Tempo Certo: ", "Right Time: ", "Tiempo Justo: "},
  {"carinhos ", "pets ", "caricias "},
  {" · boops ", " · boops ", " · toquecitos "},
  // ── confirmações, alertas ──
  {"Zerar cronômetro?", "Reset stopwatch?", "¿Reiniciar cronómetro?"},
  {"Cancelar Pomodoro?", "Cancel Pomodoro?", "¿Cancelar Pomodoro?"},
  {"Restaurar padrão de fábrica?", "Restore factory settings?", "¿Restablecer de fábrica?"},
  {"apaga ajustes, recordes e Wi-Fi", "erases settings, records and Wi-Fi", "borra ajustes, récords y Wi-Fi"},
  {"Esquecer rede de casa?", "Forget home network?", "¿Olvidar red de casa?"},
  {"apelido e recordes ficam", "nickname and records stay", "apodo y récords se mantienen"},
  {"Abrir configuração?", "Open setup?", "¿Abrir configuración?"},
  {"rede própria do Tuba", "Tuba's own network", "red propia del Tuba"},
  {"Sessão interrompida", "Session interrupted", "Sesión interrumpida"},
  {"Cronômetro ", "Stopwatch ", "Cronómetro "},
  {"(o tempo desligado não é contado)", "(time while off is not counted)", "(el tiempo apagado no se cuenta)"},
  {"Aviso", "Alert", "Aviso"},
  {" acabou!", " is done!", " terminó"},
  {"Foco concluído!", "Focus complete!", "¡Enfoque completado!"},
  {"Pausa acabou!", "Break is over!", "¡Terminó la pausa!"},
  {"Lembrete", "Reminder", "Recordatorio"},
  {"Adiar 5 min", "Snooze 5 min", "Posponer 5 min"},
  {"Adiar 10", "Snooze 10", "Posponer 10"},
  {"vire para baixo: adiar", "turn face down: snooze", "voltéalo: posponer"},
  {"Toque contínuo?", "Continuous touch?", "¿Toque continuo?"},
  {"tire o dedo / limpe a tela", "lift your finger / clean the screen", "levanta el dedo / limpia la pantalla"},
  {"segure para configurar...", "hold to set up...", "mantén para configurar..."},
  {"solte para configurar", "release to set up", "suelta para configurar"},
  // ── atualizações ──
  {"Versão instalada", "Installed version", "Versión instalada"},
  {"Nova versão", "New version", "Nueva versión"},
  {"disponível", "available", "disponible"},
  {"Buscando...", "Checking...", "Buscando..."},
  {"Tudo em dia", "Up to date", "Todo al día"},
  {"Atualizações online em breve", "Online updates coming soon", "Actualizaciones en línea pronto"},
  {"Conecte o Wi-Fi de casa", "Connect to home Wi-Fi", "Conecta el Wi-Fi de casa"},
  {"agendada para", "scheduled for", "programada para"},
  {"Atualizar agora", "Update now", "Actualizar ahora"},
  {"Esta noite", "Tonight", "Esta noche"},
  {"Atualização disponível", "Update available", "Actualización disponible"},
  {"melhorias e novidades", "improvements and new features", "mejoras y novedades"},
  {"Agora", "Now", "Ahora"},
  {"Em 1 hora", "In 1 hour", "En 1 hora"},
  {"Sem internet: instala ao conectar", "No internet: installs when connected", "Sin internet: se instala al conectar"},
  {"Aviso de novo em 1 hora", "Reminder again in 1 hour", "Aviso de nuevo en 1 hora"},
  {"Instala esta noite, às 3h", "Installs tonight at 3 AM", "Se instala esta noche a las 3"},
  {"Buscando atualizações...", "Checking for updates...", "Buscando actualizaciones..."},
  {"Não foi possível buscar agora", "Couldn't check right now", "No se pudo buscar ahora"},
  {"Você já tem a versão mais nova", "You have the latest version", "Ya tienes la versión más nueva"},
  // ── reações lendárias ──
  {"Reação lendária desbloqueada!", "Legendary reaction unlocked!", "¡Nueva reacción legendaria!"},
  {"Olhar o relógio", "Checking the time", "Mirar el reloj"},
  {"confere as horas de vez em quando", "checks the time now and then", "revisa la hora de vez en cuando"},
  {"Joinha", "Thumbs up", "Pulgar arriba"},
  {"aprova o seu dia", "approves of your day", "aprueba tu día"},
  {"Peixinho passando", "Fish passing by", "Pececito pasando"},
  {"um peixe passa e dá água na boca", "a fish swims by, mouth watering", "pasa un pez y se le hace agua la boca"},
  {"Pegou o peixe!", "Caught the fish!", "¡Atrapó el pez!"},
  {"às vezes o peixe não escapa", "sometimes the fish doesn't get away", "a veces el pez no escapa"},
  {"Cafezinho", "Coffee time", "Cafecito"},
  {"só pela manhã", "mornings only", "solo por la mañana"},
  {"Meditação", "Meditation", "Meditación"},
  {"um momento de calma", "a moment of calm", "un momento de calma"},
  {"Escada rolante", "Escalator", "Escalera eléctrica"},
  {"finge que foi embora...", "pretends to leave...", "finge que se fue..."},
  {"Que barulho!", "So loud!", "¡Qué ruido!"},
  {"quando alguém grita perto", "when someone shouts nearby", "cuando alguien grita cerca"},
  {"Bocejo", "Yawn", "Bostezo"},
  {"quando a noite chega", "when night falls", "cuando llega la noche"},
  {"hmmm...", "mmm...", "mmm..."},
  {"nham!", "yum!", "¡ñam!"},
  {"ahh...", "ahh...", "ahh..."},
  {"ommm", "ommm", "ommm"},
  {"tchau!", "bye!", "¡chao!"},
  {"hehe", "hehe", "jeje"},
  {"ufa!", "phew!", "¡uf!"},
  // ── expressões ──
  {"Feliz", "Happy", "Feliz"},
  {"Neutro", "Neutral", "Neutral"},
  {"Triste", "Sad", "Triste"},
  {"Surpreso", "Surprised", "Sorprendido"},
  {"Apaixonado", "In love", "Enamorado"},
  {"Sonolento", "Sleepy", "Somnoliento"},
  {"Bravo", "Angry", "Enojado"},
  {"Olhos em X", "X eyes", "Ojos en X"},
  {"Piscada", "Blink", "Parpadeo"},
  {"Piscadinha esq.", "Left wink", "Guiño izq."},
  {"Piscadinha dir.", "Right wink", "Guiño der."},
  {"Carinho", "Pet", "Caricia"},
  {"Foco", "Focus", "Enfoque"},
  {"Descanso", "Rest", "Descanso"},
  {"Acerto", "Hit", "Acierto"},
  {"Quase!", "Almost!", "¡Casi!"},
  {"Comemoração", "Celebration", "Celebración"},
  {"Esperando", "Waiting", "Esperando"},
  {"Tímido", "Shy", "Tímido"},
  {"Focado", "Focused", "Concentrado"},
  {"Vitorioso", "Victorious", "Victorioso"},
  {"Satisfeito", "Satisfied", "Satisfecho"},
  {"Espantado", "Amazed", "Asombrado"},
  {"Precisão", "Precision", "Precisión"},
  {"Dançante", "Groovy", "Bailarín"},
  {"Zen", "Zen", "Zen"},
  {"Mergulhador", "Diver", "Buzo"},
  {"Radiante", "Radiant", "Radiante"},
  {"Tonto", "Dizzy", "Mareado"},
  {"Assustado", "Startled", "Asustado"},
  {"Apertado", "Squint", "Apretado"},
  {"Carregando", "Charging", "Cargando"},
  {"Cansado", "Tired", "Cansado"},
  {"Curioso", "Curious", "Curioso"},
  {"1º carinho", "1st pet", "1.ª caricia"},
  {"1º Pomodoro completo", "1st Pomodoro done", "1.er Pomodoro completo"},
  {"10 corais no Pula, Tuba!", "10 corals in Jump, Tuba!", "10 corales en ¡Salta, Tuba!"},
  {"5 peixes na Hora do Bote", "5 fish in Snap Time", "5 peces en Hora del Bocado"},
  {"5 reflexos válidos", "5 valid reflexes", "5 reflejos válidos"},
  {"98% no Tempo Certo", "98% in Right Time", "98% en Tiempo Justo"},
  {"Dançar 30 s com música", "Dance 30 s to music", "Bailar 30 s con música"},
  {"3 sessões de respiração", "3 breathing sessions", "3 sesiones de respiración"},
  {"20 peixes no Mergulho", "20 fish in Dive", "20 peces en Buceo"},
  {"Todas as outras", "All the others", "Todas las demás"},
  // ── cores, corpo, cidades, fusos ──
  {"Vermelho", "Red", "Rojo"},
  {"Azul", "Blue", "Azul"},
  {"Branco", "White", "Blanco"},
  {"Grafite", "Graphite", "Grafito"},
  {"Ciano", "Cyan", "Cian"},
  {"Verde", "Green", "Verde"},
  {"Lilás", "Lilac", "Lila"},
  {"Rosa", "Pink", "Rosa"},
  {"Amarelo", "Yellow", "Amarillo"},
  {"Laranja", "Orange", "Naranja"},
  // ── jogos ──
  {"Pula, Tuba!", "Jump, Tuba!", "¡Salta, Tuba!"},
  {"Tuba Reflexo", "Tuba Reflex", "Tuba Reflejo"},
  {"Hora do Bote", "Snap Time", "Hora del Bocado"},
  {"No Tempo Certo", "Right Time", "Tiempo Justo"},
  {"Mergulho do Tuba", "Tuba's Dive", "Buceo del Tuba"},
  {"segure para sair", "hold to exit", "mantén para salir"},
  {"Toque: jogar de novo", "Tap: play again", "Toca: jugar de nuevo"},
  {"PAUSA", "PAUSED", "PAUSA"},
  {"toque para seguir", "tap to continue", "toca para seguir"},
  {"Toque para pular", "Tap to jump", "Toca para saltar"},
  {"os corais", "the corals", "los corales"},
  {"Pontos: ", "Score: ", "Puntos: "},
  {"Novo recorde!", "New record!", "¡Nuevo récord!"},
  {"Ops! Quase!", "Oops! Almost!", "¡Uy! ¡Casi!"},
  {"toque: pular · segure: sair", "tap: jump · hold: exit", "toca: saltar · mantén: salir"},
  {"Espere o AGORA!", "Wait for NOW!", "¡Espera el AHORA!"},
  {"e toque rápido", "and tap fast", "y toca rápido"},
  {"ESPERE...", "WAIT...", "ESPERA..."},
  {"não toque ainda", "don't tap yet", "no toques todavía"},
  {"AGORA!", "NOW!", "¡AHORA!"},
  {"Uau! Relâmpago!", "Wow! Lightning!", "¡Guau! ¡Relámpago!"},
  {"Rápido!", "Fast!", "¡Rápido!"},
  {"Boa!", "Nice!", "¡Bien!"},
  {"Dá pra melhorar", "You can do better", "Se puede mejorar"},
  {"Melhor: ", "Best: ", "Mejor: "},
  {"Cedo demais!", "Too early!", "¡Demasiado pronto!"},
  {"Rodada inválida", "Invalid round", "Ronda inválida"},
  {"Tempo esgotado", "Time's up", "Se acabó el tiempo"},
  {"Rodada interrompida", "Round interrupted", "Ronda interrumpida"},
  {"(sem recorde)", "(no record)", "(sin récord)"},
  {"Toque com o peixe", "Tap with the fish", "Toca con el pez"},
  {"TODO dentro do quadro", "FULLY inside the frame", "TODO dentro del recuadro"},
  {"NHAC!", "CHOMP!", "¡ÑAM!"},
  {"toque com o peixe no quadro", "tap with the fish in the frame", "toca con el pez en el recuadro"},
  {"Peixes: ", "Fish: ", "Peces: "},
  {"Escapou!", "Got away!", "¡Se escapó!"},
  {"Pare o tempo em:", "Stop the time at:", "Detén el tiempo en:"},
  {" s", " s", " s"},
  {"Alvo ", "Target ", "Objetivo "},
  {"VAI!", "GO!", "¡YA!"},
  {"toque para parar", "tap to stop", "toca para detener"},
  {" · Você ", " · You ", " · Tú "},
  {"Diferença ", "Difference ", "Diferencia "},
  {"Passou de 20 s!", "Over 20 s!", "¡Pasó de 20 s!"},
  {"Rodada encerrada", "Round over", "Ronda terminada"},
  {"Arraste o dedo", "Drag your finger", "Arrastra el dedo"},
  {"pegue peixes, fuja das águas-vivas", "catch fish, avoid jellyfish", "atrapa peces, evita las medusas"},
  {"Fim do mergulho", "Dive over", "Fin del buceo"},
};
